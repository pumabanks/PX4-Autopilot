## src/examples/px4_simple_app/Kconfig
```kconfig
menuconfig EXAMPLES_PX4_SIMPLE_APP
	bool "vtol_takeoff_safety_override"
	default n
	---help---
		Enable support for vtol_takeoff_safety_override
```

## src/modules/super_awesome_module/Kconfig
```kconfig
menuconfig MODULES_SUPER_AWESOME_MODULE
	bool "super_awesome_module"
	default y
	---help---
		Enable support for super awesome functions like hello-world
```
